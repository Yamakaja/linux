## Documentation/devicetree/bindings/iio/adc/adi,ad9083.yaml
```yaml
# SPDX-License-Identifier: (GPL-2.0 OR BSD-2-Clause)
# Copyright 2021 Analog Devices Inc.
%YAML 1.2
---
$id: http://devicetree.org/schemas/iio/adc/adi,ad9083.yaml#
$schema: http://devicetree.org/meta-schemas/core.yaml#

title: Analog Devices AD9083 device driver

maintainers:
  - Cristian Pop <cristian.pop@analog.com>

description: |
  Bindings for the Analog Devices AD9083 ADC device. Datasheet can be found
  here:
    https://www.analog.com/media/en/technical-documentation/data-sheets/ad9083.pdf

properties:
  compatible:
    enum:
      - adi,ad9083

  '#address-cells':
    const: 1

  '#size-cells':
    const: 0

  reg:
    maxItems: 1

  jesd204-device: true

  '#jesd204-cells':
    const: 2

  jesd204-top-device:
    const: 0

  jesd204-link-ids:
    const: 0

  jesd204-inputs:
    description: Inputs

  spi-max-frequency:
    const: 1000000

  clocks:
    maxItems: 1

  clock-names:
    description: AD9083 reference clock name

  adi,sampling-frequency:
    description: Sampling frequency of the device per channel
    $ref: /schemas/types.yaml#/definitions/uint64
    const: 125000000

  adi,vmax-microvolt:
    description: Full scale voltage
    minimum: 500
    maximum: 2000

  adi,fc:
    description: Cut-off frequency of low-pass filter
    $ref: /schemas/types.yaml#/definitions/uint64

  adi,rterm:
    description: ADC front end termination resistor
    $ref: /schemas/types.yaml#/definitions/uint32
    enum: [0, 1, 2]

  adi,en_hp:
    description: Enable/disable high performance
    $ref: /schemas/types.yaml#/definitions/uint32
    minimum: 0
    maximum: 1

  adi,backoff:
    description: The backoff in terms of noise terms of noise, 100 * dB
    $ref: /schemas/types.yaml#/definitions/uint32
    minimum: 0
    maximum: 18000

  adi,finmax-hz:
    description: maximum input frequency, should be set to fADC/20
    $ref: /schemas/types.yaml#/definitions/uint32

  adi,nco_freq-hz:
    description: NCO frequency
    $ref: /schemas/types.yaml#/definitions/uint32

  adi,decimation:
    description: Decimation config
    $ref: /schemas/types.yaml#/definitions/uint8

  adi,nco0_datapath_mode:
    description: NCO data path
    $ref: /schemas/types.yaml#/definitions/uint8
    enum: [1, 2, 3, 4, 5, 6]

  adi,octets-per-frame:
    description: Number of octets per frame (F)
    $ref: /schemas/types.yaml#/definitions/uint8

  adi,frames-per-multiframe:
    description: Number of frames per multi-frame (K)
    $ref: /schemas/types.yaml#/definitions/uint16

  adi,converter-resolution:
    description: Converter resolution (N)
    $ref: /schemas/types.yaml#/definitions/uint8

  adi,bits-per-sample:
    description: Number of bits per sample (N')
    $ref: /schemas/types.yaml#/definitions/uint8

  adi,converters-per-device:
    description: Number of converter per device (M)
    $ref: /schemas/types.yaml#/definitions/uint8

  adi,control-bits-per-sample:
    description: Number of control bits per conversion sample (CS)
    $ref: /schemas/types.yaml#/definitions/uint8

  adi,lanes-per-device:
    description: Number of lanes per link (L)
    $ref: /schemas/types.yaml#/definitions/uint8

  adi,subclass:
    description: The JESD204B sublcass
    $ref: /schemas/types.yaml#/definitions/uint8


required:
  - compatible
  - '#address-cells'
  - '#size-cells'
  - reg
  - jesd204-device
  - '#jesd-cells'
  - jesd204-top-device
  - jesd204-link-ids
  - jesd204-inputs
  - spi-max-frequency
  - clocks
  - clock-names
  - adi,sampling-frequency
  - adi,vmax-microvolt
  - adi,fc
  - adi,rterm
  - adi,en_hp
  - adi,backoff
  - adi,finmax-hz
  - adi,nco_freq-hz
  - adi,decimation
  - adi,nco0_datapath_mode
  - adi,octets-per-frame
  - adi,frames-per-multiframe
  - adi,converter-resolution
  - adi,bits-per-sample
  - adi,converters-per-device
  - adi,control-bits-per-sample
  - adi,lanes-per-device
  - adi,subclass

additionalProperties: false

examples:
  - |
    #include <dt-bindings/iio/adc/adi,ad9083.h>

    adc0_ad9083: ad9083@0 {
        compatible = "adi,ad9083";
        #address-cells = <1>;
        #size-cells = <0>;
        reg = <0>;
        jesd204-device;
        #jesd204-cells = <2>;
        jesd204-top-device = <0>;
        jesd204-link-ids = <0>;
        jesd204-inputs = <&axi_ad9083_core_rx 0 0>;

        spi-max-frequency = <1000000>;
        clocks = <&ad9528 13>;
        clock-names = "adc_ref_clk";

        adi,sampling-frequency = /bits/ 64 <125000000>;

        /* adi_ad9083 config */

        adi,vmax-microvolt = <1800>;
        adi,fc =  /bits/ 64 <800000000>;
        adi,rterm = <AD9083_ADC_TERM_RES_100>;
        adi,en_hp = <0>;
        adi,backoff = <0>;
        adi,finmax-hz = /bits/ 64 <100000000>;
        adi,nco_freq-hz = /bits/ 64 <0 0 0>;
        adi,decimation = /bits/ 8 <AD9083_CIC_DEC_4 AD9083_J_DEC_4 0 0>;
        adi,nco0_datapath_mode = /bits/ 8 <AD9083_DATAPATH_ADC_CIC_J>;

        /* JESD204 parameters */

        adi,octets-per-frame = <8>;
        adi,frames-per-multiframe = <32>;
        adi,converter-resolution = <16>;
        adi,bits-per-sample = <16>;
        adi,converters-per-device = <16>;
        adi,control-bits-per-sample = <0>;
        adi,lanes-per-device = <4>;
        adi,subclass = <0>;
      };
```
